/**********************************************************************************************************
 * ssd1289.c
 *
 *  Created on: 23/06/2015
 *      Author: albert
 *
 *  						    ************	*****		***		************
 *     							************	******		***		************
 *      						***				***  *** 	***		***
 *      						***				***	   ***  ***		***
 *      						***				***     *** ***		***
 *      						************	***		 ******		************
 *      						************	***		  *****		************
 *
 **********************************************************************************************************/


/***********************************************************
 * Includes
 ***********************************************************/
#include <msp430.h>
#include "ssd1289.h"


/**********************************************************
 *
 * 						Variables
 * 				    ASCII Table Array
 *
 **********************************************************/
const unsigned char font_ascii[95][16] =
{
	{0x00,0x00,0x00,0x00,0x00,0x00,0x00,0x00,0x00,0x00,0x00,0x00,0x00,0x00,0x00,0x00},/*" ",0*/

	{0x00,0x00,0x00,0x18,0x3C,0x3C,0x3C,0x18,0x18,0x00,0x18,0x18,0x00,0x00,0x00,0x00},/*"!",1*/
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	{0x00,0x00,0x00,0x71,0xDB,0x8E,0x00,0x00,0x00,0x00,0x00,0x00,0x00,0x00,0x00,0x00},/*"~",94*/
};

/***********************************************************
 * Set Maximum Frequency Clock
************************************************************/

void setupDCO(void)
{
		SetVcoreUp (0x01);
		SetVcoreUp (0x02);
		SetVcoreUp (0x03);
		UCSCTL3 = SELREF_2;                       // Set DCO FLL reference = REFO
		UCSCTL4 |= SELA_2;                        // Set ACLK = REFO
		__bis_SR_register(SCG0);                  // Disable the FLL control loop
		UCSCTL0 = 0x0000;                         // Set lowest possible DCOx, MODx
		UCSCTL1 = DCORSEL_7;                      // Select DCO range 50MHz operation
		UCSCTL2 = FLLD_0 + 487;                   // Set DCO Multiplier for 25MHz
		                                              // (N + 1) * FLLRef = Fdco
		                                              // (762 + 1) * 32768 = 25MHz
		                                              // Set FLL Div = fDCOCLK/2
		__bic_SR_register(SCG0);                  // Enable the FLL control loop
		// Worst-case settling time for the DCO when the DCO range bits have been
		// changed is n x 32 x 32 x f_MCLK / f_FLL_reference. See UCS chapter in 5xx
		// UG for optimization.
		// 32 x 32 x 25 MHz / 32,768 Hz ~ 780k MCLK cycles for DCO to settle
		__delay_cycles(782000);
		// Loop until XT1,XT2 & DCO stabilizes - In this case only DCO has to stabilize
		do
		{
		  UCSCTL7 &= ~(XT2OFFG + XT1LFOFFG + DCOFFG);
		                                              // Clear XT2,XT1,DCO fault flags
		  SFRIFG1 &= ~OFIFG;                      // Clear fault flags
		}while (SFRIFG1&OFIFG);                   // Test oscillator fault flag

}

void SetVcoreUp (unsigned int level)
{
	// Open PMM registers for write
	  PMMCTL0_H = PMMPW_H;
	  // Set SVS/SVM high side new level
	  SVSMHCTL = SVSHE + SVSHRVL0 * level + SVMHE + SVSMHRRL0 * level;
	  // Set SVM low side to new level
	  SVSMLCTL = SVSLE + SVMLE + SVSMLRRL0 * level;
	  // Wait till SVM is settled
	  while ((PMMIFG & SVSMLDLYIFG) == 0);
	  // Clear already set flags
	  PMMIFG &= ~(SVMLVLRIFG + SVMLIFG);
	  // Set VCore to new level
	  PMMCTL0_L = PMMCOREV0 * level;
	  // Wait till new level reached
	  if ((PMMIFG & SVMLIFG))
	    while ((PMMIFG & SVMLVLRIFG) == 0);
	  // Set SVS/SVM low side to new level
	  SVSMLCTL = SVSLE + SVSLRVL0 * level + SVMLE + SVSMLRRL0 * level;
	  // Lock PMM registers for write access
	  PMMCTL0_H = 0x00;
}


/*****************************************************
 * Init ssd1289 sending init commands
 ****************************************************/
void init_TFT(void)
{

		ssd1289_rest_high();__delay_cycles(50);
		ssd1289_rest_low();	__delay_cycles(50);
		ssd1289_rest_high();__delay_cycles(50);

		ssd1289_send(0x0000,0x0001);
		ssd1289_send(0x0003,0xA8A4);
		ssd1289_send(0x000C,0x0000);
		ssd1289_send(0x000D,0x080C);
		ssd1289_send(0x000E,0x2B00);
		ssd1289_send(0x001E,0x00B7);
		ssd1289_send(0x0001,0x2B3F);
		ssd1289_send(0x0002,0x0600);
		ssd1289_send(0x0010,0x0000);
		ssd1289_send(0x0011,0x6070);
		ssd1289_send(0x0005,0x0000);
		ssd1289_send(0x0006,0x0000);
		ssd1289_send(0x0016,0xEF1C);
		ssd1289_send(0x0017,0x0003);
		ssd1289_send(0x0007,0x0233);
		ssd1289_send(0x000B,0x0000);
		ssd1289_send(0x000F,0x0000);
		ssd1289_send(0x0041,0x0000);
		ssd1289_send(0x0042,0x0000);
		ssd1289_send(0x0048,0x0000);
		ssd1289_send(0x0049,0x013F);
		ssd1289_send(0x004A,0x0000);
		ssd1289_send(0x004B,0x0000);
		ssd1289_send(0x0044,0xEF00);
		ssd1289_send(0x0045,0x0000);
		ssd1289_send(0x0046,0x013F);
		ssd1289_send(0x0030,0x0707);
		ssd1289_send(0x0031,0x0204);
		ssd1289_send(0x0032,0x0204);
		ssd1289_send(0x0033,0x0502);
		ssd1289_send(0x0034,0x0507);
		ssd1289_send(0x0035,0x0204);
		ssd1289_send(0x0036,0x0204);
		ssd1289_send(0x0037,0x0502);
		ssd1289_send(0x003A,0x0302);
		ssd1289_send(0x003B,0x0302);
		ssd1289_send(0x0023,0x0000);
		ssd1289_send(0x0024,0x0000);
		ssd1289_send(0x0025,0x8000);
		ssd1289_send(0x004f,0x0000);
		ssd1289_send(0x004e,0x0000);
}

/*****************************************************
 * Separate data between commnads and data
 ****************************************************/
void ssd1289_send(uint16_t cmd, uint16_t data)
{
	ssd1289_send_cmd(cmd);
	ssd1289_send_data(data);
}

/*****************************************************
 * prepare command to send
 ****************************************************/
void ssd1289_send_cmd(uint16_t raw)
{
	ssd1289_rs_low();
	ssd1289_write(raw);
}
/*****************************************************
 * prepare data to send
 ****************************************************/
void ssd1289_send_data(uint16_t raw)
{
	ssd1289_rs_high();
	ssd1289_write(raw);
}

/*****************************************************
 * Send data (74hc595)
 ****************************************************/
void ssd1289_write(uint16_t raw)
{
	int i;
	stcp_low();
	for(i=0;i<16;i++)
	{
		(raw&0x01)?data_high():data_low();
		 raw = raw>>1;
		 shcp_high();
		 shcp_low();
	}

	stcp_high();
	stcp_low();
	data_low();

	ssd1289_wr_low();
	ssd1289_wr_high();
}
/*****************************************************
 * Paint background screen
 ****************************************************/
void ssd1289_fill(uint16_t color)
{
	uint16_t i, j;
	ssd1289_send(0x0022, color);
	for(i=0; i < SSD1289_HEIGHT; i++)
	{
		for(j=0; j < SSD1289_WIDTH; j++)
		{
			ssd1289_wr_low();
			ssd1289_wr_high();
		}
	}
}

/*****************************************************
 * Draw a rectangle
 ****************************************************/
void ssd1289_rectangle(uint16_t color, uint16_t y, uint16_t x, uint16_t height, uint16_t width)
{
	ssd1289_hline(color, y, x, width);
	ssd1289_vline(color, y, x, height);

	ssd1289_hline(color, y+height, x, width);
	ssd1289_vline(color, y, x+width, height);
}

void ssd1289_fill_rectangle(uint16_t color, uint16_t y, uint16_t x, uint16_t height, uint16_t width)
{
	uint16_t tx;

	for(tx=x;tx<(width+x); tx++)
	{
			ssd1289_vline(color, y, tx, height);
	}


}

/*****************************************************
 * Draw a horitzontal line
 ****************************************************/
void ssd1289_hline(uint16_t color, uint16_t y, uint16_t x, uint16_t width)
{
	uint16_t tx;

	for(tx = x; tx <= x + width; tx++)
	{
		ssd1289_pixel(color, y, tx);
	}
}

/*****************************************************
 * Draw a vertical line
 ****************************************************/
void ssd1289_vline(uint16_t color, uint16_t y, uint16_t x, uint16_t height)
{
	uint16_t ty;

	for(ty = y; ty <= y + height; ty++)
	{
		ssd1289_pixel(color, ty, x);
	}
}


/*****************************************************
 * Draw a diagonal line
 ****************************************************/
void ssd1289_vdiagonal(uint16_t color, uint16_t y, uint16_t x, uint16_t sy, uint16_t sx)
{
	uint16_t tx,ty;

	ty=y+sy;
	for(tx = x; tx <= x + sx; tx++)
	{
		ssd1289_pixel(color, ty, tx);
		ty--;
	}
}

/*****************************************************
 * Draw a determinate pixel
 ****************************************************/
void ssd1289_pixel(uint16_t color, uint16_t y, uint16_t x)
{
	/* fall in between screen */
	if(x >= 0 && x < SSD1289_WIDTH && y >= 0 && y < SSD1289_HEIGHT)
	{
		ssd1289_set_cursor(y, x);
		ssd1289_send(0x0022, color);
	}
}

/*****************************************************
 * Set the position on Screen
 ****************************************************/
void ssd1289_set_cursor(uint16_t y, uint16_t x)
{
    ssd1289_send(0x004e, y);
    ssd1289_send(0x004f, SSD1289_WIDTH - 1 - x);
}

/*****************************************************
 * Write a char
 ****************************************************/
void ssd1289_char(uint16_t color, char ch, uint16_t y, uint16_t x)
{
	if((x + 8) > SSD1289_WIDTH ||(y + 16) > SSD1289_HEIGHT)
		{
			return;
		}
		ch -= 32;
		if(!(ch < 95))
		{
			/* overflow */
			return;
		}

		char *font = (char *)font_ascii[ch];
		uint8_t i, j;
		uint8_t fch;

		for(i = 0 ; !(i > 16); i++)
		{
			fch = font[i];
			j = 8;
			while(--j)
			{
				if(fch & 0x01)
				{
					ssd1289_pixel(color, y + i, x + j);
				}

				fch >>= 1;
			}
		}
}

/*****************************************************
 * Draw a string
 ****************************************************/
void ssd1289_string(uint16_t color, char *string, uint16_t y, uint16_t x)
{
	uint16_t tx;

	for(tx = x; *string; tx += 8, string++)
	{
		ssd1289_char(color, *string, y, tx);
	}
}

/*****************************************************
 * Draw a bitmap, pixel x pixel
 ****************************************************/
void drawbitmap(uint16_t x, uint16_t y, uint16_t sx, uint16_t sy, uint16_t *data)
{

	int tx, ty;

	//ssd1289_set_cursor(x, y);

	for (ty=y; ty<sy; ty++)
	{
		for (tx=x; tx<sx; tx++)
		{
			ssd1289_set_cursor(ty, tx);
			ssd1289_send(0x0022, *data++);
		}
	}
}
